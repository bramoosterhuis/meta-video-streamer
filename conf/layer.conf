## conf/layer.conf
```bitbake
# We have a conf and classes directory, add to BBPATH
BBPATH .= ":${LAYERDIR}"

# We have recipes-* directories, add to BBFILES
BBFILES += "${LAYERDIR}/recipes-*/*/*.bb \
            ${LAYERDIR}/recipes-*/*/*.bbappend"

BBFILE_COLLECTIONS += "meta-video-streamer"
BBFILE_PATTERN_meta-video-streamer = "^${LAYERDIR}/"
BBFILE_PRIORITY_meta-video-streamer = "100"

LAYERDEPENDS_meta-video-streamer = "core"
LAYERSERIES_COMPAT_meta-video-streamer = "dunfell gatesgarth"

LICENSE_FLAGS_WHITELIST += "commercial_ffmpeg"
LICENSE_FLAGS_WHITELIST += "commercial_x264"

# WPE needs mpg123 gstreamer plugin
LICENSE_FLAGS_WHITELIST += "commercial_mpg123"
LICENSE_FLAGS_WHITELIST += "commercial_gstreamer1.0-plugins-ugly"

# WPE on rpi needs the OpenMAX gstreamer plugin
LICENSE_FLAGS_WHITELIST += "commercial_libomxil"
LICENSE_FLAGS_WHITELIST += "commercial_gstreamer1.0-omx"
LICENSE_FLAGS_WHITELIST += "${@bb.utils.contains('MACHINE_FEATURES', 'vc4graphics', 'commercial_gstreamer1.0-libav', '', d)}"

# WPE needs gstreamer plugins that need faad2
LICENSE_FLAGS_WHITELIST += "commercial_faad2"

BBMASK += "poky/meta/recipes-multimedia/ffmpeg/ffmpeg_*\.bb.*" 
BBMASK += "poky/meta/recipes-multimedia/gstreamer/*\.bb.*"

PREFERRED_VERSION_linux-raspberrypi = "5.4%"

DISTRO_FEATURES_remove = "\
    x11 \
    wayland \
    vulkan \
"
DISTRO_FEATURES_append = "\
    ipv4 \
    ipv6 \
    bluetooth \
    wifi \
    nfs \
    smbfs\
    opengl\
"
```
